#ifdef VECDECODE_C
#define VECDECODE_C

#if defined(_MSC_VER)
#define ALIGNED(x) __declspec(align(x))
#else
#if defined(__GNUC__)
#define ALIGNED(x) __attribute__ ((aligned(x)))
#endif
#endif

static uint8_t lengthTable[256] = {
    0, 1, 1, 2, 1, 2, 2, 3, 1, 2, 2, 3, 2, 3, 3, 4,
    1, 2, 2, 3, 2, 3, 3, 4, 2, 3, 3, 4, 3, 4, 4, 5,
    1, 2, 2, 3, 2, 3, 3, 4, 2, 3, 3, 4, 3, 4, 4, 5,
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    4, 5, 5, 6, 5, 6, 6, 7, 5, 6, 6, 7, 6, 7, 7, 8
};


static uint32_t vecDecodeTable[256][8] ALIGNED(16)  = {
    { 0, 0, 0, 0, 0, 0, 0, 0 }, /* 0x00 (00000000) */
    { 1, 0, 0, 0, 0, 0, 0, 0 }, /* 0x01 (00000001) */
    { 2, 0, 0, 0, 0, 0, 0, 0 }, /* 0x02 (00000010) */
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    { 1, 2, 3, 4, 5, 6, 7, 8 }  /* 0xFF (11111111) */
};


static int bitmap_decode_avx2(uint8_t *bitmapInPtr, size_t bitsin, uint32_t *out) {
	uint32_t *initout = out;
	__m256i baseVec = _mm256_set1_epi32(-1);
	__m256i incVec = _mm256_set1_epi32(64);
	__m256i add8 = _mm256_set1_epi32(8);

	int sizeinwords = bitsin / 64;
	uint64_t * array = (uint64_t *) bitmapInPtr;

	for (int i = 0; i < sizeinwords; ++i) {
		uint64_t w = array[i];
		if (w == 0) {
			baseVec = _mm256_add_epi32(baseVec, incVec);
		} else {
			for (int k = 0; k < 4; ++k) {
				uint8_t byteA = (uint8_t) w;
				uint8_t byteB = (uint8_t)(w >> 8);
				w >>= 16;
				__m256i vecA = _mm256_load_si256((const __m256i *) vecDecodeTable[byteA]);
				__m256i vecB = _mm256_load_si256((const __m256i *) vecDecodeTable[byteB]);
				uint8_t advanceA = lengthTable[byteA];
				uint8_t advanceB = lengthTable[byteB];
				vecA = _mm256_add_epi32(baseVec, vecA);
				baseVec = _mm256_add_epi32(baseVec, add8);
				vecB = _mm256_add_epi32(baseVec, vecB);
				baseVec = _mm256_add_epi32(baseVec, add8);
				_mm256_storeu_si256((__m256i *) out, vecA);
				out += advanceA;
				_mm256_storeu_si256((__m256i *) out, vecB);
				out += advanceB;
			}
		}
	}
  if((bitsin % 64) != 0) {
    // finish off the work the slow way.
    uint64_t bitset = 0;
    memcpy(&bitset,bitmapInPtr,sizeof(bitset));
    bitset = bitset & ((UINT64_C(1)<<(bitsin % 64))-1);
    while (bitset != 0) {
        uint64_t t = bitset & -bitset;
        int r = __builtin_ctzll(bitset);
        *out = sizeinwords * 64 + r;
        out++;
        bitset ^= t;
    }
  }
	return out - initout;
}

#endif
